// Adapte du tutoriel EastRising Technology (buydisplay.com) pour
// ER-OLEDM032-1 / SSD1322, repointe sur les broches SPI de l'ESP32-C3
// (config.h) et limite a l'affichage texte.

#include "er_oled.h"
#include "config.h"
#include <SPI.h>

static const uint8_t AsciiLib[] PROGMEM = {
    0x00,0x00,0x00,0x00,0x00,0x00,0x00,0x00,0x00,0x00,0x00,0x00,0x00,0x00,0x00,0x00,    /*   */
    0x00,0x00,0x00,0x10,0x10,0x10,0x10,0x10,0x10,0x10,0x00,0x00,0x18,0x18,0x00,0x00,    /* ! */
    0x00,0x00,0x00,0x00,0x00,0x00,0x14,0x28,0x28,0x50,0x00,0x00,0x00,0x00,0x00,0x00,    /* " */
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    0x00,0x00,0x00,0x00,0x00,0x7E,0x44,0x08,0x10,0x10,0x22,0x7E,0x00,0x00,0x00,0x00,    /* z */
};

static void oled_command(uint8_t cmd) {
  digitalWrite(PIN_OLED_DC, LOW);
  digitalWrite(PIN_OLED_CS, LOW);
  SPI.transfer(cmd);
  digitalWrite(PIN_OLED_CS, HIGH);
}

static void oled_data(uint8_t dat) {
  digitalWrite(PIN_OLED_DC, HIGH);
  digitalWrite(PIN_OLED_CS, LOW);
  SPI.transfer(dat);
  digitalWrite(PIN_OLED_CS, HIGH);
}

// Convertit 1 octet noir/blanc (8 pixels) en 4 octets de niveaux de gris
// (2 pixels par octet, format SSD1322 4 bits/pixel).
static void data_processing(uint8_t temp) {
  uint8_t hi, lo;
  hi = (temp & 0x80) ? 0xF0 : 0x00;
  lo = (temp & 0x40) ? 0x0F : 0x00;
  oled_data(hi | lo);
  hi = (temp & 0x20) ? 0xF0 : 0x00;
  lo = (temp & 0x10) ? 0x0F : 0x00;
  oled_data(hi | lo);
  hi = (temp & 0x08) ? 0xF0 : 0x00;
  lo = (temp & 0x04) ? 0x0F : 0x00;
  oled_data(hi | lo);
  hi = (temp & 0x02) ? 0xF0 : 0x00;
  lo = (temp & 0x01) ? 0x0F : 0x00;
  oled_data(hi | lo);
}

void er_oled_SetWindow(uint8_t Xstart, uint8_t Ystart, uint8_t Xend, uint8_t Yend) {
  oled_command(0x15);
  oled_data(Xstart + 0x1C);
  oled_data(Xend + 0x1C);
  oled_command(0x75);
  oled_data(Ystart);
  oled_data(Yend);
  oled_command(0x5C);  // write RAM
}

void er_oled_clear() {
  er_oled_SetWindow(0x00, 0x00, 0x77, 0x7F);
  for (int row = 0; row < 128; row++) {
    for (int i = 0; i < 240; i++) {
      oled_data(0x00);
    }
  }
}

void er_oled_char(uint8_t x, uint8_t y, const char *ascii, uint8_t mode) {
  x = x / 4;
  uint16_t offset = (*ascii - 32) * 16;
  er_oled_SetWindow(x, y, x + 1, y + 15);
  for (uint8_t i = 0; i < 16; i++) {
    uint8_t b = pgm_read_byte(&AsciiLib[offset + i]);
    if (mode) b = ~b;
    data_processing(b);
  }
}

void er_oled_string(uint8_t x, uint8_t y, const char *pString, uint8_t mode) {
  while (*pString != 0) {
    er_oled_char(x, y, pString, mode);
    x += 8;
    pString += 1;
  }
}

void er_oled_begin() {
  pinMode(PIN_OLED_RST, OUTPUT);
  pinMode(PIN_OLED_DC, OUTPUT);
  pinMode(PIN_OLED_CS, OUTPUT);

  // Broches SPI personnalisees : sck, miso (non cable), mosi, ss
  SPI.begin(PIN_OLED_CLK, -1, PIN_OLED_MOSI, PIN_OLED_CS);
  SPI.beginTransaction(SPISettings(20000000, MSBFIRST, SPI_MODE0));

  digitalWrite(PIN_OLED_CS, LOW);
  digitalWrite(PIN_OLED_RST, HIGH);
  delay(10);
  digitalWrite(PIN_OLED_RST, LOW);
  delay(10);
  digitalWrite(PIN_OLED_RST, HIGH);

  oled_command(0xFD);  // set command lock
  oled_data(0x12);     // unlock
  oled_command(0xAE);  // display off
  oled_command(0xB3);  // clock divider / osc frequency
  oled_data(0x91);
  oled_command(0xCA);  // multiplex ratio
  oled_data(0x3F);     // duty = 1/64
  oled_command(0xA2);  // display offset
  oled_data(0x00);
  oled_command(0xA1);  // start line
  oled_data(0x00);
  oled_command(0xA0);  // set remap
  oled_data(0x14);
  oled_data(0x11);
  oled_command(0xAB);  // function selection
  oled_data(0x01);     // external VDD
  oled_command(0xB4);
  oled_data(0xA0);
  oled_data(0xFD);
  oled_command(0xC1);  // contrast current
  oled_data(0x80);
  oled_command(0xC7);  // master contrast current control
  oled_data(0x0F);
  oled_command(0xB1);  // phase length
  oled_data(0xE2);
  oled_command(0xD1);
  oled_data(0x82);
  oled_data(0x20);
  oled_command(0xBB);  // pre-charge voltage
  oled_data(0x1F);
  oled_command(0xB6);  // second pre-charge period
  oled_data(0x08);
  oled_command(0xBE);  // VCOMH
  oled_data(0x07);
  oled_command(0xA6);  // normal display
  oled_command(0xAF);  // display on
}
